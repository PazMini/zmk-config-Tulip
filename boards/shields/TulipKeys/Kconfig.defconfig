## boards/shields/TulipKeys/Kconfig.defconfig
```kconfig
if SHIELD_TULIPKEYS_LEFT

config ZMK_KEYBOARD_NAME
    default "TulipKeys"

config ZMK_SPLIT_ROLE_CENTRAL
    default y

endif

if SHIELD_TULIPKEYS_LEFT || SHIELD_TULIPKEYS_RIGHT

config ZMK_SPLIT
    default y

endif
```

## boards/shields/TulipKeys/Kconfig.shield
```kconfig
config SHIELD_TULIPKEYS_LEFT
    def_bool $(shields_list_contains,tulipkeys_left)

config SHIELD_TULIPKEYS_RIGHT
    def_bool $(shields_list_contains,tulipkeys_right)
```
